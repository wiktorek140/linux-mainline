## Documentation/devicetree/bindings/regulator/qcom-labibb-regulator.txt
```
Qualcomm's LAB(LCD AMOLED Boost)/IBB(Inverting Buck Boost) Regulator

LAB can be used as a positive boost power supply and IBB can be used as a negative
boost power supply for display panels. Currently implemented for pmi8998.

Main node required properties:

- compatible:			Must be:
				"qcom,pmi8998-lab-ibb"
- #address-cells:		Must be 1
- #size-cells:			Must be 0

LAB subnode required properties:

- interrupts:			Specify the interrupts as per the interrupt
				encoding.
- interrupt-names:		Interrupt names to match up 1-to-1 with
				the interrupts specified in 'interrupts'
				property.

IBB subnode required properties:

- interrupts:			Specify the interrupts as per the interrupt
				encoding.
- interrupt-names:		Interrupt names to match up 1-to-1 with
				the interrupts specified in 'interrupts'
				property.

Example:
	pmi8998_lsid1: pmic@3 {
		labibb {
			compatible = "qcom,pmi8998-lab-ibb";
			#address-cells = <1>;
			#size-cells = <0>;

			lab: lab {
				interrupts = <0x3 0xde 0x0 IRQ_TYPE_EDGE_RISING>;
				interrupt-names = "lab-sc-err";
			};

			ibb: ibb {
				interrupts = <0x3 0xdc 0x2 IRQ_TYPE_EDGE_RISING>;
				interrupt-names = "ibb-sc-err";
			};

		};
	};
```

## drivers/dma/qcom/Kconfig
```kconfig
# SPDX-License-Identifier: GPL-2.0-only
config QCOM_BAM_DMA
	tristate "QCOM BAM DMA support"
	depends on ARCH_QCOM || (COMPILE_TEST && OF && ARM)
	select DMA_ENGINE
	select DMA_VIRTUAL_CHANNELS
	---help---
	  Enable support for the QCOM BAM DMA controller.  This controller
	  provides DMA capabilities for a variety of on-chip devices.

config QCOM_HIDMA_MGMT
	tristate "Qualcomm Technologies HIDMA Management support"
	select DMA_ENGINE
	help
	  Enable support for the Qualcomm Technologies HIDMA Management.
	  Each DMA device requires one management interface driver
	  for basic initialization before QCOM_HIDMA channel driver can
	  start managing the channels. In a virtualized environment,
	  the guest OS would run QCOM_HIDMA channel driver and the
	  host would run the QCOM_HIDMA_MGMT management driver.

config QCOM_HIDMA
	tristate "Qualcomm Technologies HIDMA Channel support"
	select DMA_ENGINE
	help
	  Enable support for the Qualcomm Technologies HIDMA controller.
	  The HIDMA controller supports optimized buffer copies
	  (user to kernel, kernel to kernel, etc.).  It only supports
	  memcpy interface. The core is not intended for general
	  purpose slave DMA.

config SPS
	bool "SPS support"
	depends on HAS_IOMEM
	select GENERIC_ALLOCATOR
	default y
	help
	  The SPS (Smart Peripheral Switch) is a DMA engine.
	  It can move data in the following modes:
		1. Peripheral-to-Peripheral.
		2. Peripheral-to-Memory.
		3. Memory-to-Memory.

config SPS_SUPPORT_BAMDMA
	bool "SPS support BAM DMA"
	depends on SPS
	default n
	help
	  The BAM-DMA is used for Memory-to-Memory transfers.
	  The main use cases is RPC between processors.
	  The BAM-DMA hardware has 2 registers sets:
	  1. A BAM HW like all the peripherals.
	  2. A DMA channel configuration (i.e. channel priority).
```
